## kernel/Kconfig
```kconfig
# SPDX-License-Identifier: GPL-2.0
#
menu "Rtochius Kernel configuration"

source "kernel/init/Kconfig"

source "kernel/drivers/Kconfig"

source "kernel/lib/Kconfig"

source "kernel/librtochius/Kconfig"

source "kernel/lib/Kconfig.debug"

endmenu
```

## kernel/arch/arm64/configs/defconfig
```kconfig
CONFIG_BUILD_VERSION_AUTO=y
CONFIG_ARCH_ORIGIN=y
CONFIG_ARM64_VA_BITS_48=y
CONFIG_NR_CPUS=8
CONFIG_OF_FLATTREE=y
CONFIG_SERIAL_AMBA_PL01X=y
CONFIG_FDT=y
CONFIG_QEMU_VIRT=y
CONFIG_QEMU_APPEND="console=ttyAMA0 rodata=nofull"
```

## kernel/drivers/irqchip/Kconfig
```kconfig
menu "IRQ chip support"

config IRQCHIP
	def_bool y

config ARM_GIC
	bool

endmenu
```

## kernel/drivers/of/Kconfig
```kconfig
menuconfig OF
	bool "Device Tree and Open Firmware support"
	help
	  This option enables the device tree infrastructure.
	  It is automatically selected by platforms that need it or can
	  be enabled manually for unittests, overlays or
	  compile-coverage.

if OF

config OF_FLATTREE
	bool "Device Tree flattree"
	default n

config OF_RESERVED_MEM
	depends on OF_FLATTREE
	bool
	help
	  Helpers to allow for reservation of memory regions

endif
```

## kernel/drivers/serial/Kconfig
```kconfig
menu "Serial drivers"

config SERIAL_AMBA_PL01X
	bool "ARM AMBA PL01X serial port support"
	help
	  This selects the ARM(R) AMBA(R) PrimeCell PL011 UART.  If you have
	  an Integrator/PP2, Integrator/CP or Versatile platform, say Y or M
	  here.

	  If unsure, say N.

endmenu
```
